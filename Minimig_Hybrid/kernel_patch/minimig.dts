/dts-v1/;
/plugin/;
/{
fragment@0 {
  target-path = "/";
  __overlay__ {
  	minimig_irq {
          compatible = "minimig_irq";
          interrupt-parent = <0x02>;
          interrupts = <0 42 1>;
        };
  };
};
};
